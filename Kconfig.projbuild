## main/Kconfig.projbuild
```kconfig
menu "StudioPieters"

    config ESP_LED_GPIO
        int "Identify LED GPIO"
        default 23
        help
            GPIO for the HomeKit identify LED. Blinks on HomeKit identify
            request. Not exposed as a HomeKit service.

    config ESP_BUTTON_GPIO
        int "Physical button GPIO"
        default 25
        help
            GPIO for the physical push button wired GND -> button -> GPIO.
            Uses active-low logic with internal pull-up enabled in main.c.
            Avoid bootstrapping pins (0, 2, 5, 12, 15).
            Single press: OTA update/reboot.
            Double press: HomeKit reset + restart.
            Long press: factory reset + reboot.

    config ESP_RELAY_OPEN_GPIO
        int "OPEN (UP) relay GPIO"
        default 16
        help
            GPIO driving the relay that opens / raises the sunshade.
            Never activated simultaneously with the CLOSE relay.

    config ESP_RELAY_CLOSE_GPIO
        int "CLOSE (DOWN) relay GPIO"
        default 17
        help
            GPIO driving the relay that closes / lowers the sunshade.
            Never activated simultaneously with the OPEN relay.

    config ESP_RELAY_ACTIVE_LEVEL
        int "Relay active level"
        default 1
        range 0 1
        help
            GPIO level that ENERGISES a relay.
            1 = active-high boards (relay on when the input pin is HIGH).
            0 = active-low boards — the common opto-isolated 2-channel modules
                where the relay turns on when the input pin is pulled LOW.
            If both relays click on at boot and the motor runs unexpectedly,
            your board is active-low: set this to 0.

    config ESP_RELAY_REVERSE_DELAY_MS
        int "Direction-reversal dead time (ms)"
        default 500
        range 0 5000
        help
            Minimum time both relays are held OFF before energising the opposite
            direction. AC tubular motors must not be reversed instantly; a short
            dead time protects the motor and its run capacitor. 0 disables it.

    config ESP_TTP_UP_GPIO
        int "TTP223 UP signal GPIO"
        default 32
        help
            Digital signal from the UP TTP223 touch module.

    config ESP_TTP_STOP_GPIO
        int "TTP223 STOP signal GPIO"
        default 33
        help
            Digital signal from the STOP TTP223 touch module.

    config ESP_TTP_DOWN_GPIO
        int "TTP223 DOWN signal GPIO"
        default 27
        help
            Digital signal from the DOWN TTP223 touch module.

    config ESP_TTP_ACTIVE_LEVEL
        int "TTP223 active level"
        default 1
        range 0 1
        help
            Use 1 for active-high TTP223 modules.
            Use 0 only if your module is configured as active-low.

    config ESP_TTP_POLL_MS
        int "TTP223 poll interval (ms)"
        default 25
        range 10 200
        help
            Polling interval for the TTP223 digital inputs.

    config ESP_TTP_DEBOUNCE_MS
        int "TTP223 debounce time (ms)"
        default 60
        range 10 500
        help
            Debounce time for stable TTP223 touch detection.

    config SUNSHADE_FULL_TRAVEL_TIME_MS
        int "Full travel time (ms)"
        default 20000
        range 1000 120000
        help
            Time in milliseconds for the sunshade motor to travel the full
            distance from 0 % to 100 %, or vice versa. Used for time-based
            position estimation when not calibrated.

    config ESP_SETUP_CODE
        string "HomeKit Setup Code"
        default "582-94-633"
        help
            HomeKit pairing code. Changing this value requires a new QR code.

    config ESP_SETUP_ID
        string "HomeKit Setup ID"
        default "7MX2"
        help
            HomeKit setup ID. Changing this value requires a new QR code.

    menu "Wind Speed Sensor (optional)"

        config WIND_SENSOR_ENABLE
            bool "Enable wind speed sensor (HWFS-1 / 0-4 V anemometer)"
            default n
            help
                Enable the HWFS-1 passive anemometer (0–4 V analog output).
                The sensor is self-powered by wind rotation — no external VCC needed.
                Wiring: signal wire (black+stripe) → voltage divider → ADC GPIO.
                        ground wire (solid black) → GND.
                The 4 V output must be divided to ≤3.3 V before the ADC pin.
                Recommended divider: R1=10 kΩ + R2=22 kΩ → 4 V becomes 2.75 V.
                Only ADC1 GPIOs (GPIO32–39) are supported; ADC2 conflicts with WiFi.

        config WIND_SENSOR_ADC_GPIO
            int "Wind sensor ADC GPIO"
            default 34
            range 32 39
            depends on WIND_SENSOR_ENABLE
            help
                ADC1 GPIO connected to the voltage-divided sensor signal wire.
                GPIO34 and GPIO35 are input-only and are the recommended choice.

        config WIND_SENSOR_ADC_FULL_SCALE_MV
            int "ADC voltage at sensor full-scale output (mV)"
            default 2270
            range 100 3300
            depends on WIND_SENSOR_ENABLE
            help
                ADC input voltage (mV) when the sensor outputs its maximum voltage.
                ESP32 ADC_ATTEN_DB_11 accurate range: 150–2450 mV.
                For the HWFS-1 0–3.3 V version:
                  R1=10 kΩ + R2=22 kΩ → 3300 × 22/32 = 2269 mV ≈ 2270 mV (default, safe).
                For a 0–4 V sensor:
                  R1=10 kΩ + R2=15 kΩ → 4000 × 15/25 = 2400 mV.
                Change only if you use a different resistor ratio or sensor output range.

        config WIND_SENSOR_MAX_SPEED_DS
            int "Wind speed at ADC full scale (dm/s, 1 dm/s = 0.1 m/s)"
            default 140
            range 10 1000
            depends on WIND_SENSOR_ENABLE
            help
                Wind speed (in dm/s) at the sensor's maximum output voltage.
                For the HWFS-1 0–3.3 V version: full scale = 14 m/s = 140 dm/s (default).
                The HWFS-1 uses a DC generator whose V-vs-speed curve is nonlinear
                at very low RPM (cogging torque, brush friction). Calibrate against
                a reference instrument and adjust this value if readings differ.
                Previous 0–4 V HWFS-1 empirical value: 103 dm/s (V×2.58=m/s).

        config WIND_SENSOR_CLOSE_THRESHOLD_DS
            int "Auto-close threshold (dm/s)"
            default 80
            range 10 1000
            depends on WIND_SENSOR_ENABLE
            help
                Wind speed above which the sunshade closes automatically for protection.
                80 = 8.0 m/s (Beaufort 5 — recommended maximum for most sunshades).
                Typical sunshade manufacturer limits: 6–10 m/s.
                After field calibration, verify this threshold with a reference meter.

        config WIND_SENSOR_REOPEN_THRESHOLD_DS
            int "Re-open hysteresis threshold (dm/s)"
            default 50
            range 10 1000
            depends on WIND_SENSOR_ENABLE
            help
                Wind speed below which the sunshade restores its previous position
                after a wind-protection close. Must be lower than the close threshold
                to prevent rapid cycling.

        config WIND_SENSOR_POLL_MS
            int "Wind sensor poll interval (ms)"
            default 2000
            range 500 30000
            depends on WIND_SENSOR_ENABLE
            help
                Interval between wind speed readings. Each reading averages 16 ADC
                samples internally to reduce commutator ripple and brush noise.
                2000 ms is a good default; cup anemometers respond within 1–3 s.

    endmenu

    menu "Rain Sensor (optional)"

        config RAIN_SENSOR_ENABLE
            bool "Enable rain sensor (MH-RD)"
            default n
            help
                Enable a digital rain sensor module (MH-RD or compatible FC-37/YL-83).
                When rain is detected the sunshade closes automatically and restores
                its previous position when rain stops.
                Wiring: VCC → 3.3 V, GND → GND, DO → GPIO (AO not used).
                Sensitivity is adjustable via the onboard potentiometer.

        config RAIN_SENSOR_GPIO
            int "Rain sensor digital output GPIO"
            default 35
            depends on RAIN_SENSOR_ENABLE
            help
                GPIO connected to the sensor module's DO (digital output) pin.
                GPIO35 is input-only and is the recommended choice.
                Avoid bootstrapping pins (0, 2, 5, 12, 15).

        config RAIN_SENSOR_ACTIVE_LEVEL
            int "Rain sensor active level"
            default 0
            range 0 1
            depends on RAIN_SENSOR_ENABLE
            help
                Level of the DO pin when rain is detected.
                0 = active-low (default — most FC-37/YL-83 modules with LM393).
                1 = active-high (uncommon; check your module datasheet).

        config RAIN_SENSOR_POLL_MS
            int "Rain sensor poll interval (ms)"
            default 500
            range 100 5000
            depends on RAIN_SENSOR_ENABLE
            help
                Interval between digital reads of the DO pin.
                500 ms is a good default for rain detection.

        config RAIN_SENSOR_DEBOUNCE_MS
            int "Rain sensor debounce time (ms)"
            default 2000
            range 500 30000
            depends on RAIN_SENSOR_ENABLE
            help
                The DO pin must remain stable for this long before a state change
                is acted upon. 2000 ms prevents false triggers from brief drizzle
                or sensor noise. Applies to both rain-start and rain-stop events.

    endmenu

    menu "Light Sensor (optional)"

        config LUX_SENSOR_ENABLE
            bool "Enable ambient light sensor (BH1750)"
            default n
            help
                Enable a BH1750 (GY-302) digital ambient-light sensor over I2C.
                When the measured illuminance rises above the close threshold the
                sunshade lowers automatically for sun protection, and restores its
                previous position once the light drops below the reopen threshold.
                Wiring: VCC -> 3.3 V, GND -> GND, SDA/SCL -> the GPIOs below,
                ADDR -> GND (address 0x23) or 3.3 V (address 0x5C).

        config LUX_SENSOR_SDA_GPIO
            int "BH1750 I2C SDA GPIO"
            default 21
            depends on LUX_SENSOR_ENABLE
            help
                GPIO connected to the BH1750 SDA pin. Default ESP32 SDA is GPIO21.

        config LUX_SENSOR_SCL_GPIO
            int "BH1750 I2C SCL GPIO"
            default 22
            depends on LUX_SENSOR_ENABLE
            help
                GPIO connected to the BH1750 SCL pin. Default ESP32 SCL is GPIO22.

        config LUX_SENSOR_I2C_ADDR
            hex "BH1750 I2C address"
            default 0x23
            range 0x23 0x5C
            depends on LUX_SENSOR_ENABLE
            help
                7-bit I2C address. 0x23 when ADDR is tied to GND (default),
                0x5C when ADDR is tied to 3.3 V.

        config LUX_SENSOR_CLOSE_THRESHOLD_LUX
            int "Auto-close threshold (lux)"
            default 40000
            range 1 100000
            depends on LUX_SENSOR_ENABLE
            help
                Illuminance above which the sunshade closes for sun protection.
                Bright direct sunlight is roughly 30000-100000 lux; an overcast
                day is a few thousand lux. 40000 is a sensible default.

        config LUX_SENSOR_REOPEN_THRESHOLD_LUX
            int "Re-open hysteresis threshold (lux)"
            default 20000
            range 1 100000
            depends on LUX_SENSOR_ENABLE
            help
                Illuminance below which the sunshade restores its previous
                position. Must be lower than the close threshold to prevent
                rapid cycling when the light hovers near the limit.

        config LUX_SENSOR_POLL_MS
            int "Light sensor poll interval (ms)"
            default 5000
            range 1000 60000
            depends on LUX_SENSOR_ENABLE
            help
                Interval between BH1750 reads. The sensor needs ~120 ms per
                high-resolution conversion; 5000 ms avoids reacting to passing
                clouds while staying responsive.

    endmenu

endmenu
```
